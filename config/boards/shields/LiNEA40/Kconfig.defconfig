## config/boards/shields/LiNEA40/Kconfig.defconfig
```kconfig
config LINEA40_PAIR2
    bool "Distinct split identity for a second LiNEA40"
    help
      Build both halves of a second LiNEA40 with this enabled. The right
      half is named LiNEA40-2 so hosts can tell the pairs apart.

if SHIELD_LiNEA40_RIGHT
    config ZMK_KEYBOARD_NAME
        default "LiNEA40-2" if LINEA40_PAIR2
        default "LiNEA40"
    config ZMK_SPLIT_ROLE_CENTRAL
        default y
endif

if SHIELD_LiNEA40_LEFT || SHIELD_LiNEA40_RIGHT
    config ZMK_SPLIT
        default y
endif
```
